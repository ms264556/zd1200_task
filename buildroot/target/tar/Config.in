## buildroot/target/tar/Config.in
```kconfig
config BR2_TARGET_ROOTFS_TAR
	bool "tar the root filesystem"
	default n
	help
	  Build a tar archive of the root filesystem

config BR2_TARGET_ROOTFS_TAR_OPTIONS
	string "random options to pass to tar"
	depends on BR2_TARGET_ROOTFS_TAR
	default ""
	help
	  Common options:
	   j - compress with bzip2
	   z - compress with gzip

config BR2_TARGET_DATAFS_TAR
	bool "tar the data filesystem"
	default n
	help
	  Build a tar archive of the data filesystem

config BR2_TARGET_DATAFS_TAR_OPTIONS
	string "random options to pass to tar"
	depends on BR2_TARGET_DATAFS_TAR
	default "z"
	help
	  Common options:
	   j - compress with bzip2
	   z - compress with gzip

config BR2_TARGET_DATAFS_TAR_APIMG
	bool "also includes AP images"
	depends on BR2_TARGET_DATAFS_TAR
	default y
	help
	  Include AP images

config BR2_TARGET_DATAFS_TAR_APIMG_SOURCE
	string "AP image source path"
	depends BR2_TARGET_DATAFS_TAR_APIMG
#	default "$(BUILD_DIR)/controller/ac/etc/download"
#	default "/tmp/fd_img_dir"
	default "$(AC_DIR)/etc/apimages"
	help
	  Where to find AP images

config BR2_TARGET_DATAFS_TAR_OUTPUT
	string "Output File"
	depends on BR2_TARGET_DATAFS_TAR
	default "$(BUILD_DIR)/datafs.$(ARCH).tar.$(PROFILE)"
	help
	  Output file name

config BR2_TARGET_DATAFS_TAR_COPYTO
	string "also copy the image to..."
	depends on BR2_TARGET_DATAFS_TAR
	default "/tftpboot"
	help
	  Copies the resulting image to a secondary location.
```

## buildroot/target/usbtool/Config.in
```kconfig
config BR2_TARGET_USBTOOL_KIT
	bool "Enable USB tool kits"
	default n
	help
	  Create USB tool kits for system rescue.

config BR2_USB_TOOL_TARGET_DIR
	string "USB initramfs output path"
	depends on BR2_TARGET_USBTOOL_KIT
	default "$(TFTPBOOT)"
	help
	  Output path to the initramfs of usb tool kit
```

## buildroot/target/vmdkimage/Config.in
```kconfig
config BR2_TARGET_VMDK_IMAGE
	bool "Generate VMDK disk image"
	depends on BR2_TARGET_ISO_INSTALLER
	default n
	help
	  Build VMDK image

config BR2_VMDK_IMAGE_TARGET_DIR
	string "VMDK disk image output path"
	depends on BR2_TARGET_VMDK_IMAGE
	default "$(TFTPBOOT)/$(PROFILE)"
	help
	  Output path of VMDK image

config BR2_VMDK_IMAGE_SIZE
	string "Disk size of VMDK image"
	depends on BR2_TARGET_VMDK_IMAGE
	default "2G"
	help
	  Disk size of VMDK image
```

## buildroot/toolchain/binmd5/Config.in
```kconfig
config BR2_PACKAGE_BINMD5_TARGET
	bool "Install binmd5 for the target system"
	default n
	help
	  Utility to build Firmware download image from a compressed binary image.

config BR2_PACKAGE_BINMD5_HOST
	bool "Install binmd5 for the host/build system"
	default y
	help
	  Utility to build Firmware download image from ELF file
```

## buildroot/toolchain/binutils/Config.in
```kconfig
# Choose binutils version.

comment "Binutils Options"

choice
	prompt "Binutils Version"
	default BR2_BINUTILS_VERSION_2_16_1
	help
	  Select the version of binutils you wish to use.

	config BR2_BINUTILS_VERSION_2_14_90_0_8
		depends !BR2_nios2
		bool "binutils 2.14.90.0.8"

	config BR2_BINUTILS_VERSION_2_15
		bool "binutils 2.15"

	config BR2_BINUTILS_VERSION_2_15_94_0_2_2
		depends !BR2_nios2
		bool "binutils 2.15.94.0.2.2"

	config BR2_BINUTILS_VERSION_2_15_97
		depends !BR2_nios2
		bool "binutils 2.15.97"

	config BR2_BINUTILS_VERSION_2_16
		bool "binutils 2.16"

	config BR2_BINUTILS_VERSION_2_16_1
		depends !BR2_nios2
		bool "binutils 2.16.1"

	config BR2_BINUTILS_VERSION_2_17
		depends on !BR2_avr32
		depends on BR2_DEPRECATED
		bool "binutils 2.17"

	config BR2_BINUTILS_VERSION_2_18
		bool "binutils 2.18"

	config BR2_BINUTILS_VERSION_2_19
		depends on !BR2_avr32
		bool "binutils 2.19"

	config BR2_BINUTILS_VERSION_2_19_1
		depends on !BR2_avr32
		bool "binutils 2.19.1"

	config BR2_BINUTILS_VERSION_2_20
		depends on !BR2_avr32
		bool "binutils 2.20"

	config BR2_BINUTILS_VERSION_2_20_1
		depends on !BR2_avr32
		bool "binutils 2.20.1"

endchoice

config BR2_BINUTILS_VERSION
	string
	default "2.14.90.0.8"     if BR2_BINUTILS_VERSION_2_14_90_0_8
	default "2.15"            if BR2_BINUTILS_VERSION_2_15
	default "2.15.94.0.2.2"   if BR2_BINUTILS_VERSION_2_15_94_0_2_2
	default "2.15.97"         if BR2_BINUTILS_VERSION_2_15_97
	default "2.16"            if BR2_BINUTILS_VERSION_2_16
	default "2.16.1"          if BR2_BINUTILS_VERSION_2_16_1
	default "2.17"		  if BR2_BINUTILS_VERSION_2_17
	default "2.18"            if BR2_BINUTILS_VERSION_2_18
	default "2.19"		  if BR2_BINUTILS_VERSION_2_19
	default "2.19.1"	  if BR2_BINUTILS_VERSION_2_19_1
	default "2.20"		  if BR2_BINUTILS_VERSION_2_20
	default "2.20.1"	  if BR2_BINUTILS_VERSION_2_20_1


config BR2_EXTRA_BINUTILS_CONFIG_OPTIONS
        string "Additional binutils options"
        default ""
        help
            Any additional binutils options you may want to include..
```

## buildroot/toolchain/kernel-headers/Config.in
```kconfig
# Choose the kernel headers to use for kernel-headers target. This is
# ignored if you are building your own kernel or using the system kernel.
#

comment "Kernel Header Options"

config BR2_KERNEL_HEADERS_FROM_KERNEL_SRC
	depends on !BR2_nios2
	depends on BR2_LINUX_KERNEL
	bool "Use the kernel headers from the kernel source dir"

choice
	prompt "Kernel Headers"
	help
	  Select the version of kernel header files you wish to use.
	  You must select the correct set of header files to match
	  the kernel you intend to use on your target system.

	  For the snapshot, you have to provide the
	  linux-2.6.tar.bz2 tarball in your download dir.

	config BR2_KERNEL_HEADERS_2_4_25
		bool "Linux 2.4.25 kernel headers"

	config BR2_KERNEL_HEADERS_2_4_27
		depends on !BR2_nios2
		bool "Linux 2.4.27 kernel headers"

	config BR2_KERNEL_HEADERS_2_4_29
		depends on !BR2_nios2
		bool "Linux 2.4.29 kernel headers"

	config BR2_KERNEL_HEADERS_2_4_31
		depends on !BR2_avr32 && !BR2_nios2
		bool "Linux 2.4.31 kernel headers"

	config BR2_KERNEL_HEADERS_2_6_9
		bool "Linux 2.6.9 kernel headers"

	config BR2_KERNEL_HEADERS_2_6_11
		bool "Linux 2.6.11 kernel headers"

	config BR2_KERNEL_HEADERS_2_6_12
		depends on !BR2_nios2
		bool "Linux 2.6.12 kernel headers"

	config BR2_KERNEL_HEADERS_2_6_15
		depends on !BR2_nios2
		bool "Linux 2.6.15 kernel headers"

	config BR2_KERNEL_HEADERS_2_6_32
		bool "Linux 2.6.32.x kernel headers"

endchoice

config BR2_DEFAULT_KERNEL_HEADERS
	string
	default "2.4.25"    if BR2_KERNEL_HEADERS_2_4_25
	default "2.4.27"    if BR2_KERNEL_HEADERS_2_4_27
	default "2.4.29"    if BR2_KERNEL_HEADERS_2_4_29
	default "2.4.31"    if BR2_KERNEL_HEADERS_2_4_31
	default "2.6.9"     if BR2_KERNEL_HEADERS_2_6_9
	default "2.6.11"    if BR2_KERNEL_HEADERS_2_6_11
	default "2.6.12"    if BR2_KERNEL_HEADERS_2_6_12
	default "2.6.15"    if BR2_KERNEL_HEADERS_2_6_15
	default "2.6.32.24" if BR2_KERNEL_HEADERS_2_6_32
```

## buildroot/toolchain/uClibc/Config.in
```kconfig
# Choose uClibc options
#

comment "uClibc Options"

config BR2_UCLIBC_VERSION
	string "uClibc version"
	default "0.9.28"

config BR2_UCLIBC_CONFIG
	string "Config file for uClibc"
	default "$(BR2_UCLIBC_CONFIG)"


config BR2_UCLIBC_VERSION_SNAPSHOT
	bool "Use a daily snapshot of uClibc?"
	default n
	help
 	    Would you like to use a daily snapshot?

config BR2_USE_UCLIBC_SNAPSHOT
	string "Date (yyyymmdd) of snapshot or 'snapshot' for latest"
	default "snapshot"
	depends on BR2_UCLIBC_VERSION_SNAPSHOT
	help
	    Use latest snapshot or one from a specific date?

config BR2_UCLIBC_BUILD_DEBUG
	bool "Debug build with symbol (no stripped)?"
	default n
	help
	   Build debug version of uClibc with symbol (no stripped)?

config BR2_ENABLE_LOCALE
	bool "Enable locale/gettext/i18n support?"
	default n
	help
	    Enable locale/gettext/i18n support?

config BR2_UCLIBC_USBTOOL
	bool "Enable uClibc for USB tool kit"
	default n
	depends on BR2_TARGET_USBTOOL_KIT 
	help
	    Enable uClibc for USB tool
choice
	prompt "Thread library implementation"
	default BR2_PTHREADS_OLD
	help
	  Select the version of libpthreads you want to use.

	config BR2_PTHREADS_NONE
		bool "none"

	config BR2_PTHREADS
		bool "linuxthreads"

	config BR2_PTHREADS_OLD
		bool "linuxthreads (stable/old)"

	config BR2_PTHREADS_NATIVE
		bool "Native POSIX Threading (NPTL)"
endchoice
```

## linux/kernels/linux-mips/drivers/net/ag7100/Kconfig
```kconfig
#
# AG7100 configuration
#

config AG7100
	tristate "Atheros AR7100 GigE"
	depends on MACH_AR7100
	help
	  This enables the building of Atheros AR7100 gigE driver module.
	  Note that this module cannot be compiled as built-in, currently

if AG7100

choice
	prompt "PHY (or switch) used"

config MV_PHY
	bool "Marvell 88E1116R or 88E1121R"

config BCM5397_PHY
	bool "Broadcom BCM5397"

config AG7100_GENERIC_PHY
	bool "Generic Phy"

if AG7100_GENERIC_PHY

config AG7100_GENERIC_PHY_VERBOSE
	bool "Verbose output for phy?"

endif # AG7100_GENERIC_PHY

config VITESSE_8201_PHY
	bool "Vitesse GigE Phy 8201"

config VITESSE_8601_PHY
	bool "Vitesse Gige Phy 8601"

config VITESSE_8601_7395_PHY
	bool "Vitesse Gige Phy 8601_7395"

config AG7100_ICPLUS_PHY
	bool "IP Icplus Phy"

config AG7100_REALTEK_PHY
	bool "Rtl8201"

config ADM6996FC_PHY
	bool "AdmTek 6996FC"

config BROADCOM_AC201_PHY
	bool "Broadcom ethernet chip AC201"

endchoice

config VENETDEV
	bool "enable venetdev"

choice
	prompt "port 0 interface"

config AG7100_GE0_MII
	bool "MII mode"

config AG7100_GE0_RMII
	bool "RMII mode"

config AG7100_GE0_RGMII
	bool "RGMII mode"

config AG7100_GE0_GMII
	bool "GMII mode"

endchoice

config AG7100_GE1_IS_CONNECTED
	bool "port 1 is connected to a PHY"

if AG7100_GE1_IS_CONNECTED

choice
	prompt "port 1 interface (depends on port0)"

config AG7100_GE1_RMII
	bool "RMII mode"

config AG7100_GE1_RGMII
	bool "RGMII mode"

endchoice

endif # AG7100_GE1_IS_CONNECTED

config AG7100_DMA_HANG_FIX
	bool "DMA hang fix"
	help
	  This enables Atheros AR7100 GigE Rx/Tx DMA hang fix:
	  Rx and Tx DMA hangs and goes to an invalid state in HOWL boards
	  when the link partner is forced to 10/100 Mode. By resetting the MAC
	  we are able to recover from this state. This is a software WAR and
	  will be removed once we have a hardware fix.

endif # AG7100
```

## linux/kernels/linux-mips/drivers/net/atheros/Kconfig
```kconfig
#
# AG934x configuration
#

config MACH_AR934x
	tristate "Atheros AR934x GigE"
    depends on MACH_AR7100 && AG7100=n
	help
	  This enables the building of Atheros AR934x gigE driver module.
	  Note that this module cannot be compiled as built-in, currently
```

## linux/kernels/linux-mips/drivers/net/qca955x_s17/Kconfig
```kconfig
#
# QCA955x configuration
#

config MACH_QCA955x_S17
	tristate "Qualcomm QCA955x GigE"
    depends on MACH_AR7100 && AG7100=n
	help
	  This enables the building of QCA955x gigE driver module.
	  Note that this module cannot be compiled as built-in, currently
```

## linux/kernels/linux-mips/net/bridge/Kconfig
```kconfig
#
# 802.1d Ethernet Bridging
#

config BRIDGE
	tristate "802.1d Ethernet Bridging"
	select LLC
	select STP
	---help---
	  If you say Y here, then your Linux box will be able to act as an
	  Ethernet bridge, which means that the different Ethernet segments it
	  is connected to will appear as one Ethernet to the participants.
	  Several such bridges can work together to create even larger
	  networks of Ethernets using the IEEE 802.1 spanning tree algorithm.
	  As this is a standard, Linux bridges will cooperate properly with
	  other third party bridge products.

	  In order to use the Ethernet bridge, you'll need the bridge
	  configuration tools; see <file:Documentation/networking/bridge.txt>
	  for location. Please read the Bridge mini-HOWTO for more
	  information.

	  If you enable iptables support along with the bridge support then you
	  turn your bridge into a bridging IP firewall.
	  iptables will then see the IP packets being bridged, so you need to
	  take this into account when setting up your firewall rules.
	  Enabling arptables support when bridging will let arptables see
	  bridged ARP traffic in the arptables FORWARD chain.

	  To compile this code as a module, choose M here: the module
	  will be called bridge.

	  If unsure, say N.

if BRIDGE

config BRIDGE_PORT_MODE
	bool "Set mode on individual bridge port"
	default n
	---help---
	  Support setting an individual bridge port to default, UNI and hostonly mode.
	  Default and UNI port are combinedly used to support port isolation.
	  Hostonly port is used to disable forwarding traffic from that port to other port.
	  However, traffic from that port destined to local host (including broadcast,
	  multicast and unicast) is not affected.

config BRIDGE_BR_MODE
	bool "Set mode on the whole bridge"
	default n
	---help---
	  Support setting bridge to default or hostonly mode.
	  When a bridge is set to hostonly mode, traffic forwarding between different ports
	  is disabled. However, traffic destined to local host (including broadcast,
	  multicast and unicast) is not affected.

config BRIDGE_LOOP_GUARD
	bool "Turn on port flap detect feature"
	default n
	---help---
	  Turns on check rapid mac address flapping between multiple bridge ports.

# V54_BSP
config BRIDGE_PACKET_INSPECTION_FILTER
	tristate "Turn on bridge packet inspection/filtering"
	default n
	---help---
	  bridge packet inspection is a light-weight packet filter, it can peek packets
	  over bridge, then serve each packet to particulr actions. ex. proxy ARP, directed ARP.

config BRIDGE_MESH_PKT_FORWARDING_FILTER
	bool "Turn on Mesh Packet Forwarding Filter"
	default n
	---help---
	  Mesh Packet Forwarding Filter allows packets with specific MAC addresses
	  to flow only in one direction. Once a MAC (or multiple MACs) are configured,
	  the port will only allow traffic with that SRC MAC to ingress from that port
	  and only packets with that DST MAC to egress from to that port. This helps
	  prevent packet loops as well as provides some security against ARP spoofing
	  of configured MAC addresses.
# end V54_BSP

config BRIDGE_VLAN
	bool "802.1Q bridge support"
	---help---
	  If you say Y here, then your bridge will be able to filter and
	  forward packets according to their IEEE 802.1Q headers.

	  If unsure, say N.

# V54_BSP
config BRIDGE_DHCP_HOOK
	tristate "DHCP hook support"
	default n
	---help---
	  Bridge hook for dhcp packet.

config BRIDGE_DNAT_HOOK
	tristate "DNAT hook support"
	default n
	---help---
	  Bridge hook for dnat module.
config CI_WHITELIST
        tristate "Client isolation whitelist support"
        default n
        ---help---
          Whitelist infrastructure support for AP.
config SOURCE_MAC_GUARD
        tristate "Source MAC address protection (obsoletes MPFF)"
        default n
        ---help---
          Source MAC address check for ARP packets.
config ANTI_SPOOF
        tristate "Anti-spoof filter checks for AP"
        default n
        ---help---
          DHCP & DHCP responses are filtered when received on wlanX.
# end V54_BSP
endif # BRIDGE
```
