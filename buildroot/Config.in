## buildroot/package/Config.in
```kconfig
menu "Package Selection for the target"

menu "The default minimal system"
source "package/busybox/Config.in"
source "package/redboot/Config.in"
source "package/uboot/Config.in"
source "package/grub/Config.in"
endmenu

menu "The Linux Kernel Options"
source "package/linux-kernel/Config.in"
endmenu

menu "The Wireless Madwifi Driver Options"
source "package/madwifi/Config.in"
endmenu

menu "The Wireless Driver Simulation Options"
source "package/jardwifi/Config.in"
endmenu

menu "The minimum needed to build a uClibc development system"
source "package/apmgr/Config.in"
source "toolchain/ccache/Config.in.2"
source "toolchain/gcc/Config.in.2"
source "package/aruba-rap/Config.in"
source "package/aruba-l2tpd/Config.in"
source "package/aruba-pluto/Config.in"
source "package/auto-conf/Config.in"
source "package/auto-prov/Config.in"
source "package/bash/Config.in"
source "package/bzip2/Config.in"
source "package/coreutils/Config.in"
source "package/diffutils/Config.in"
source "package/ed/Config.in"
source "package/eth1xd/Config.in"
source "package/findutils/Config.in"
source "package/flex/Config.in"
source "package/freeswan/Config.in"
source "package/gawk/Config.in"
source "package/grep/Config.in"
source "package/hostapd/Config.in"
source "package/librsc/Config.in"
source "package/librsm/Config.in"
source "package/make/Config.in"
source "package/mfr/Config.in"
source "package/patch/Config.in"
source "package/rksaim/Config.in"
source "package/rkschano/Config.in"
source "package/rkscli/Config.in"
source "package/rksconfig/Config.in"
source "package/rksmcast/Config.in"
source "package/rpcapd/Config.in"
source "package/rpm/Config.in"
source "package/sed/Config.in"
source "package/syslog/Config.in"
source "package/tar/Config.in"
source "package/timer/Config.in"
source "package/webserver/Config.in"
source "package/wireless-tools/Config.in"
source "package/wpa-supplicant/Config.in"
endmenu

menu "Other stuff"
source "package/acpid/Config.in"
source "package/aerosctd/Config.in"
source "package/agqmi/Config.in"
source "package/autoconf/Config.in"
source "package/automake/Config.in"
source "package/avpd/Config.in"
source "package/bc/Config.in"
source "package/berkeleydb/Config.in"
source "package/bison/Config.in"
source "package/boa/Config.in"
source "package/bonjour/Config.in"
source "package/bridge/Config.in"
source "package/brownout/Config.in"
source "package/bsp/Config.in"
source "package/c2lib/Config.in"
source "package/ca-certs/Config.in"
source "package/cares/Config.in"
source "package/channelfly/Config.in"
source "package/ckermit/Config.in"
source "package/clusterD/Config.in"
source "package/cmm/Config.in"
source "package/coova-chilli/Config.in"
source "package/curl/Config.in"
source "package/custom/Config.in"
source "package/customize/Config.in"
source "package/cvs/Config.in"
source "package/csm/Config.in"
source "package/debug-utils/Config.in"
source "package/defaults/Config.in"
source "package/delta/Config.in"
source "package/dhcp/Config.in"
source "package/dhcp-forwarder/Config.in"
source "package/dhry/Config.in"
source "package/directfb/Config.in"
source "package/director/Config.in"
source "package/distcc/Config.in"
source "package/dlrc/Config.in"
source "package/dm/Config.in"
source "package/dmalloc/Config.in"
source "package/dnsmasq/Config.in"
source "package/dropbear/Config.in"
source "package/ebtables/Config.in"
source "package/ekahaud/Config.in"
source "package/ethreg/Config.in"
source "package/ethreg-2/Config.in"
source "package/ethtool/Config.in"
source "package/fakeroot/Config.in"
source "package/file/Config.in"
source "package/freetype/Config.in"
source "package/gettext/Config.in"
source "package/gkermit/Config.in"
source "package/gpsd/Config.in"
source "package/gzip/Config.in"
source "package/hostap/Config.in"
source "package/hotplug/Config.in"
source "package/hotspot/Config.in"
source "package/hub_registrar/Config.in"
source "package/i2c-tools/Config.in"
source "package/iostat/Config.in"
source "package/iperf/Config.in"
source "package/ipmiutil/Config.in"
source "package/ipmitool/Config.in"
source "package/iproute2/Config.in"
source "package/ipsec-tools/Config.in"
source "package/iptables/Config.in"
source "package/irqbalance/Config.in"
source "package/jpeg/Config.in"
source "package/less/Config.in"
source "package/libcache_pool/Config.in"
source "package/libccl/Config.in"
source "package/libfloat/Config.in"
source "package/libglib12/Config.in"
source "package/libgmp/Config.in"
source "package/libiconv/Config.in"
source "package/libipc_sock/Config.in"
source "package/libmad/Config.in"
source "package/libnl/Config.in"
source "package/libpcap/Config.in"
source "package/libpng/Config.in"
source "package/libsqlite3/Config.in"
source "package/librkscrypto/Config.in"
source "package/librkshash/Config.in"
source "package/libRutil/Config.in"
source "package/libsysfs/Config.in"
source "package/libtool/Config.in"
source "package/links/Config.in"
source "package/lldpd/Config.in"
source "package/generatelocalip/Config.in"
source "package/lrzsz/Config.in"
source "package/ltp-testsuite/Config.in"
source "package/ltt/Config.in"
source "package/lvm2/Config.in"
source "package/lzo/Config.in"
source "package/m4/Config.in"
source "package/mdadm/Config.in"
source "package/mdnsproxy/Config.in"
source "package/memcached/Config.in"
source "package/memtester/Config.in"
source "package/meshd/Config.in"
source "package/jardmeshd/Config.in"
source "package/microcom/Config.in"
source "package/microperl/Config.in"
source "package/microwin/Config.in"
source "package/miniupnpd/Config.in"
source "package/mkdosfs/Config.in"
source "package/module-init-tools/Config.in"
source "package/modutils/Config.in"
source "package/mosquitto/Config.in"
source "package/mosquitto_lbs_sub/Config.in"
source "package/mpg123/Config.in"
source "package/mrouted/Config.in"
source "package/msgd/Config.in"
source "package/mtd/Config.in"
source "package/nano/Config.in"
source "package/ncurses/Config.in"
source "package/ndisc6/Config.in"
source "package/ndsend/Config.in"
source "package/netcat/Config.in"
source "package/netkitbase/Config.in"
source "package/netkittelnet/Config.in"
source "package/netsnmp/Config.in"
source "package/newt/Config.in"
source "package/ntp/Config.in"
source "package/nuttcp/Config.in"
source "package/ocsp/Config.in"
source "package/omac_aes/Config.in"
source "package/openl2tp/Config.in"
source "package/openldap/Config.in"
source "package/openntpd/Config.in"
source "package/openssh/Config.in"
source "package/openssl/Config.in"
source "package/openvpn/Config.in"
source "package/parprouted/Config.in"
source "package/pciutils/Config.in"
source "package/pcmcia/Config.in"
source "package/portage/Config.in"
source "package/portmap/Config.in"
source "package/pppd/Config.in"
source "package/procps/Config.in"
source "package/python/Config.in"
source "package/qemu/Config.in"
source "package/qte/Config.in"
source "package/raidtools/Config.in"
source "package/readline/Config.in"
source "package/regdmn_chann/Config.in"
source "package/regdomain/Config.in"
source "package/registered-domain/Config.in"
source "package/rfmd/Config.in"
source "package/rfw/Config.in"
source "package/rksblistd/Config.in"
source "package/rks_nbp/Config.in"
source "package/rpkitpm/Config.in"
source "package/rp-pppoe/Config.in"
source "package/rsmd/Config.in"
source "package/rsync/Config.in"
source "package/ruda/Config.in"
source "package/rxvt/Config.in"
source "package/scand/Config.in"
source "package/sdl/Config.in"
source "package/sfdisk/Config.in"
source "package/slang/Config.in"
source "package/smsd/Config.in"
source "package/smtpclient/Config.in"
source "package/sntp/Config.in"
source "package/socat/Config.in"
source "package/ssmtp/Config.in"
source "package/stainfod/Config.in"
source "package/statd/Config.in"
source "package/sysklogd/Config.in"
source "package/tacplus/Config.in"
source "package/tcl/Config.in"
source "package/tcpdump/Config.in"
source "package/tftpd/Config.in"
source "package/tinylogin/Config.in"
source "package/tinyx/Config.in"
source "package/tn5250/Config.in"
source "package/tool4tpm/Config.in"
source "package/tpm-tools/Config.in"
source "package/tr069/Config.in"
source "package/trousers/Config.in"
source "package/ttcp/Config.in"
source "package/tunnelmgr/Config.in"
source "package/tube/Config.in"
source "package/udev/Config.in"
source "package/udhcp/Config.in"
source "package/util-linux/Config.in"
source "package/valgrind/Config.in"
source "package/vsftpd/Config.in"
source "package/vtun/Config.in"
source "package/wget/Config.in"
source "package/which/Config.in"
source "package/wide-dhcpv6/Config.in"
source "package/wps/Config.in"
source "package/wsgclient/Config.in"
source "package/xfsprogs/Config.in"
source "package/xorg/Config.in"
source "package/zlib/Config.in"
source "package/zing/Config.in"
source "package/zip/Config.in"
endmenu

menu "File System Tool"
source "package/e2fsprogs/Config.in"
source "package/reiserfsprogs/Config.in"
endmenu

menu "Test Tools"
source "package/aussie-rescue/Config.in"
source "package/chariot/Config.in"
source "package/rpmkeytest/Config.in"
source "package/testshape/Config.in"
endmenu

menu "Debug Tool"
source "package/codump/Config.in"
source "package/strace/Config.in"
source "package/libelf/Config.in"
source "package/ltrace/Config.in"
endmenu

menu "USB Tool Kit"
source "package/lipe/Config.in"
source "package/kexec/Config.in"
source "package/libusb/Config.in"
source "package/usb_default/Config.in"
source "package/usb_devmon/Config.in"
source "package/usb_modemcmd/Config.in"
source "package/usb_modeswitch/Config.in"
endmenu

menu "Packages Shared Options"
config BR2_PACKAGE_RKS_TUNNEL_EVAL
	bool "tunnel performance evaluatation support"
	help
	  Support tunnel performance evaluatation.
endmenu

endmenu
```

## buildroot/package/apmgr/Config.in
```kconfig
config BR2_PACKAGE_APMGR
	bool "AP Manager"
	depends on BR2_PACKAGE_AFMOD
	default n
	help
	  AP Manager application for communicating with Access Controller
```

## buildroot/package/aruba-l2tpd/Config.in
```kconfig
config BR2_PACKAGE_ARUBA_L2TPD
	bool "aruba-l2tpd"
	default n
	depends on BR2_PACKAGE_ARUBA_REMOTE_AP
	help
	  implementation of L2TP daemon

	  http://aruba.com/
```

## buildroot/package/aruba-pluto/Config.in
```kconfig
config BR2_PACKAGE_ARUBA_PLUTO
	bool "aruba-pluto"
	default n
	depends on BR2_PACKAGE_ARUBA_REMOTE_AP && BR2_PACKAGE_FREESWAN && BR2_PACKAGE_LIBGMP
	help
	  implementation of VPN client

	  http://aruba.com/
```

## buildroot/package/aruba-rap/Config.in
```kconfig
config BR2_PACKAGE_ARUBA_REMOTE_AP
	bool "aruba-rap"
	default n
	help
	  Enables Aruba Remote Access Point features

	  http://aruba.com/

config BR2_PACKAGE_ARUBA_PROVISION
	bool "aruba-provision"
	default n
	depends on BR2_PACKAGE_ARUBA_REMOTE_AP
	help
	    aruba provision parsing utilities
```

## buildroot/package/aussie-rescue/Config.in
```kconfig
config BR2_PACKAGE_AUSSIE_RESCUE
	bool "aussie-rescue"
	default n
	help
	  The rescue mode for Aussie.
```

## buildroot/package/bc/Config.in
```kconfig
config BR2_PACKAGE_BC
	bool "bc"
	default n
	help
          bc is an arbitrary precision numeric processing language.

          http://www.gnu.org/software/bc/
```

## buildroot/package/brownout/Config.in
```kconfig
config BR2_PACKAGE_BROWNOUT
	bool "brownout"
	default n
	help
	  brownout.

config BR2_PACKAGE_CYPRUS2_BROWNOUT
	bool "cyprus2 brownout"
	default n
	help
	  brownout.
```

## buildroot/package/c2lib/Config.in
```kconfig
config BR2_PACKAGE_C2LIB
	bool "c2lib"
	default n
	help
	  c2lib is a C library with capabilities of vector, hash, string, etc. We don't want to use STL yet we'd like some of the functionalities.
	  c2lib uses the concept of 'pool' where you don't worry about memory management when you write codes and can simply delete the pool to free all memory that's dynamically allocated
	  License: LGPL Version: 1.4.2 
	  URL:     http://www.annexia.org/freeware/c2lib/
	  Modifications:
		- make it compilable for gcc 3.4 and up
	  Notes:
		- it's not being maintained anymore
```

## buildroot/package/cares/Config.in
```kconfig
config BR2_PACKAGE_CARES
	bool "cares"
	default n
	help
	  for resolving host name asynchronously
	  http://http://c-ares.haxx.se/
```

## buildroot/package/chariot/Config.in
```kconfig
config BR2_PACKAGE_CHARIOT
	bool "chariot"
	default n
	help
	    Ixia Chariot End Point utility
```

## buildroot/package/ckermit/Config.in
```kconfig
config BR2_PACKAGE_CKERMIT
	bool "ckermit"
	default n
	help
	  Build C-Kermit for the target.

	  http://www.columbia.edu/kermit/ck80.html
```

## buildroot/package/cmm/Config.in
```kconfig
config BR2_PACKAGE_CMM
	bool "cmm"
	help
	  CMM module to communicate with xcloud
```

## buildroot/package/curl/Config.in
```kconfig
config BR2_PACKAGE_CURL
	bool "curl"
	default n
	select BR2_PACKAGE_CA-CERTS
	help
	  Network utility to retrieve files from http/ftp/etc...

	  http://curl.haxx.se/
```

## buildroot/package/debug-utils/Config.in
```kconfig
config BR2_PACKAGE_DEBUG_UTILS
	bool "debug-utils"
	help
	    System Debug utilities
```

## buildroot/package/delta/Config.in
```kconfig
config BR2_PACKAGE_DELTA_MAC
	bool "delta"
	default n
	help
	    Delta Mac Client for manufacturing support
```

## buildroot/package/dhcp-forwarder/Config.in
```kconfig
config BR2_PACKAGE_DHCP-FORWARDER
	bool "dhcp-forwarder"
	default n
	help
	  This program forwards DHCP messages between subnets with different sublayer broadcast domains.

	  http://www.nongnu.org/dhcp-fwd/
```

## buildroot/package/dhry/Config.in
```kconfig
config BR2_PACKAGE_APERF
	bool "dhry"
	default n
	help
	    AP dhrystone/cache performance testing utility
```

## buildroot/package/director/Config.in
```kconfig
config BR2_PACKAGE_DIRECTOR
	bool "director"
	default n
	help
	  Ruckus Director Application 

if BR2_PACKAGE_DIRECTOR

config BR2_PACKAGE_DIRECTOR_WITH_SIM_AP
	bool "Pack with simulated AP images?"
	default n
	help
	  Pack with simulated AP images.

config BR2_PACKAGE_RADIUS_DM
        bool "Support RADIUS Disconnect Messages"
        help
          Support RADIUS Disconnect Messages.

config BR2_PACKAGE_RADIUS_CUI
	bool "Support RADIUS CUI"
	help
	  Support RADIUS CUI.



config BR2_PACKAGE_SUPPORT_ENTITLEMENT
	bool "Support entitlement"
	help
	  Support Entitlement.

if BR2_PACKAGE_SUPPORT_ENTITLEMENT

config BR2_PACKAGE_RKS_SUPPORT_REPORT
	bool "Ruckus Support Report"
	help
	  Ruckus Support Report.

endif

endif # BR2_PACKAGE_DIRECTOR
```

## buildroot/package/dlrc/Config.in
```kconfig
config BR2_PACKAGE_DLRC
	bool "dlrc-WARNING-EXPERIMENTAL"
	default n
	depends on openssl
	help
	  Provides download-and-run-code capability in a secure manner.
	  This software is experimental at this time and not intended
	  for production use.
```

## buildroot/package/dmalloc/Config.in
```kconfig
config BR2_PACKAGE_DMALLOC
    bool "dmalloc"
    default n
    help
      The debug memory allocation or dmalloc library has been designed as a drop in 
      replacement for the system's malloc, realloc, calloc, free and other memory management 
      routines while providing powerful debugging facilities configurable at runtime. These 
      facilities include such things as memory-leak tracking, fence-post write detection, 
      file/line number reporting, and general logging of statistics. 

      http://dmalloc.com
```
