## buildroot/package/e2fsprogs/Config.in
```kconfig
config BR2_PACKAGE_E2FSPROGS
	bool "e2fsprogs"
	default n
	help
	  The EXT2 file system utilities and libraries

config BR2_PACKAGE_E2FSPROG_RESIZER
	bool "Enable resizer"
	default n
	depends on BR2_PACKAGE_E2FSPROGS
	help
	  Enable resizer tool

config BR2_PACKAGE_E2FSPROG_SYSTEM
	bool "Install e2fsprogs for system"
	default n
	depends on BR2_PACKAGE_E2FSPROGS
	help
	  Install EXT2 file system utilities to the system

config BR2_PACKAGE_E2FSPROG_USBTOOL
	bool "Install e2fsprogs for usb tool"
	default y
	depends on BR2_PACKAGE_E2FSPROGS
	depends on BR2_TARGET_USBTOOL_KIT 
	help
	  Install EXT2 file system utilities for usb tool
```

## buildroot/package/ebtables/Config.in
```kconfig
config BR2_PACKAGE_EBTABLES
	bool "ebtables"
	help
	  Linux kernel (2.4+) firewall, NAT, and packet mangling tools.

	  http://ebtables.sourceforge.net/
```

## buildroot/package/ethtool/Config.in
```kconfig
config BR2_PACKAGE_ETHTOOL
	bool "ethtool"
	default n
	help
	  Display or change ethernet card settings.

	  http://sourceforge.net/projects/gkernel/
```

## buildroot/package/freeswan/Config.in
```kconfig
config BR2_PACKAGE_FREESWAN
	bool "freeswan"
	default n
	help
	  A package that inplements IPsec on Linux.

	  http://www.freeswan.org/software/tar/
```

## buildroot/package/generatelocalip/Config.in
```kconfig
config BR2_PACKAGE_LOCALIP
	bool "localip"
	default n
	help
	  localip is a C library with capabilities of generate a local ip address.
```

## buildroot/package/gkermit/Config.in
```kconfig
config BR2_PACKAGE_GKERMIT
	bool "gkermit"
	default n
	help
	  Build G-Kermit for the target.

	  http://www.columbia.edu/kermit/gkermit.html
```

## buildroot/package/grub/Config.in
```kconfig
config BR2_PACKAGE_GRUB
	bool "grub"
	default n
	help
	  The grub bootloader

config BR2_PACKAGE_GRUB_BUILD
	string "Ruckus Grub version.build"
	depends BR2_PACKAGE_GRUB
	default "1.0"
	help
	  Ruckus version.build for Grub.

config BR2_PACKAGE_GRUB_OUTPUT_PATH
	string "grub target directory"
	depends BR2_PACKAGE_GRUB
	default "$(BUILD_DIR)/grub_bld"
	help
	  Point to path of output binary

config BR2_PACKAGE_GRUB_COPYTO
	string "also install grub for USB tool"
	depends BR2_PACKAGE_GRUB
	depends on BR2_TARGET_USBTOOL_KIT
	default "$(TFTPBOOT)/grub"
	help
	  Install Grub boot loader to another location
	  for USB tool kits

#config BR2_PACKAGE_GRUB_USBTOOL
#	bool "Intall grub for usb tool"
#	default y
#	depends on BR2_PACKAGE_GRUB
#	depends on BR2_TARGET_USBTOOL_KIT
#	help
#	  Install grub for usb tool

config BR2_PACKAGE_GRUB_EXT2
	bool "grub ext2fs support"
	depends BR2_PACKAGE_GRUB
	default n
	help
	  ext2fs support in Stage 2.


config BR2_PACKAGE_GRUB_REISER
	bool "grub resierfs support"
	depends BR2_PACKAGE_GRUB
	default n
	help
	  ReiserFS support in Stage 2.


config BR2_PACKAGE_GRUB_FAT
	bool "grub FATfs support"
	depends BR2_PACKAGE_GRUB
	default n
	help
	  FAT support in Stage 2.

config BR2_PACKAGE_GRUB_E1000
	bool "grub E1000 support"
	depends BR2_PACKAGE_GRUB
	default n
	help
	  Intel E1000 driver support.
```

## buildroot/package/hub_registrar/Config.in
```kconfig
config BR2_PACKAGE_HUB_REGISTRAR
	bool "hub-registrar"
	default n
	select BR2_PACKAGE_OCSP
	help
	  Ruckus AP Hub / Registrar Cloud Service
```

## buildroot/package/i2c-tools/Config.in
```kconfig
config BR2_PACKAGE_I2C_TOOLS
    bool "I2C_TOOLS"
    default n
    help
        This package contains an heterogeneous set of I2C tools for the Linux kernel.
        These tools were originally part of the lm-sensors project but were finally
        split into their own package for convenience. They compile, run and have been
        tested on GNU/Linux.

        http://www.lm-sensors.org/wiki/I2CTools
        http://dl.lm-sensors.org/i2c-tools/releases/i2c-tools-3.1.0.tar.bz2
```

## buildroot/package/iperf/Config.in
```kconfig
config BR2_PACKAGE_IPERF
	bool "iperf"
	default n
	help
	    The TCP/UDP bandwidth measurement tool
```

## buildroot/package/ipmitool/Config.in
```kconfig
config BR2_PACKAGE_IPMITOOL
	bool "ipmitool"
	default n
	help
	  Install ipmitool
```

## buildroot/package/ipmiutil/Config.in
```kconfig
config BR2_PACKAGE_IPMIUTIL
	bool "ipmiutil"
	default n
	help
	  Install ipmiutil tool
```

## buildroot/package/ipsec-tools/Config.in
```kconfig
config BR2_PACKAGE_IPSEC_TOOLS
	bool "ipsec-tools"
	default n
	help
	  IPsec-Tools is a port of KAME's IPsec utilities to the Linux-2.6
          IPsec implementation.

	  http://ipsec-tools.sourceforge.net/
```

## buildroot/package/irqbalance/Config.in
```kconfig
config BR2_PACKAGE_IRQBALANCE
	bool "irqbalance"
	default n
	help
	  Build irqbalance daemon
```

## buildroot/package/jardmeshd/Config.in
```kconfig
config BR2_PACKAGE_JARD_MESH
	bool "Jard mesh"
	default n
	help
	    Ruckus Jard Mesh Framework
```

## buildroot/package/libccl/Config.in
```kconfig
config BR2_PACKAGE_LIBCCL
	bool "libccl"
	help
	  C-code library for parsing config files

	  http://sbooth.org/
```

## buildroot/package/libglib12/Config.in
```kconfig
config BR2_PACKAGE_LIBGLIB12
	bool "libglib12"
	default n
	help
	  Low-level core library that forms the basis of GTK+ and GNOME.

	  http://www.gtk.org/

if BR2_PACKAGE_LIBGLIB12

config BR2_PACKAGE_LIBGLIB12_VER
	string "glib version"
	default "2.28.0"
	help
	  Version of Glib

endif # BR2_PACKAGE_LIBGLIB12
```

## buildroot/package/libgmp/Config.in
```kconfig
config BR2_PACKAGE_LIBGMP
	bool "libgmp"
	default n
	help
	  GNU Multiple Precision Arithmetic Library

	  http://www.swox.com/gmp/
```

## buildroot/package/libiconv/Config.in
```kconfig
config BR2_PACKAGE_LIBICONV
	bool "libiconv"
	default n
	help
	  GNU libiconv

	  http://www.gnu.org/software/libiconv/
```

## buildroot/package/libipc_sock/Config.in
```kconfig
config BR2_PACKAGE_LIBIPC_SOCK
	bool "Ruckus ipc socket library"
	default n
	help
	  Ruckus ipc socket library.
```

## buildroot/package/libnl/Config.in
```kconfig
config BR2_PACKAGE_LIBNL
	bool "libnl"
	default n
	help
	  This is a library for applications dealing with netlink sockets. 
	  The library provides an interface for raw netlink messaging 
	  and various netlink family specific interfaces.

	  http://packages.debian.org/lenny/libnl1
```

## buildroot/package/libsqlite3/Config.in
```kconfig
config BR2_PACKAGE_LIBSQLITE
	bool "Ruckus sqlite3 library"
	default n
	help
	  Ruckus sqlite3 library.
```

## buildroot/package/libusb/Config.in
```kconfig
config BR2_PACKAGE_LIBUSB
	bool "libusb"
	default n
	help
	  This is the home of libusb, a library that gives user level 
	  applications uniform access to USB devices across many different
	  operating systems.

	  http://www.libusb.org/
```
