## buildroot/package/scand/Config.in
```kconfig
config BR2_PACKAGE_SCAND
	bool "scand"
	default n
	help
          Ruckus daemon to run on scan radio
```

## buildroot/package/smsd/Config.in
```kconfig
config BR2_PACKAGE_SMSD
	bool "smsd"
	default n
	depends on BR2_PACKAGE_IPMIUTIL
	help
	  Ruckus smsd for ZD5K/WSG platform
```

## buildroot/package/smtpclient/Config.in
```kconfig
config BR2_PACKAGE_SMTPCLIENT
	bool "mail: Simple SMTP Client"
	default n
	help
	  Client to send mail to a SMTP server
```

## buildroot/package/ssmtp/Config.in
```kconfig
config BR2_PACKAGE_SSMTP
	bool "ssmtp"
	default n
	help
	  A Busybox externel tiny utility named "ssmtp", an extremely simple Mail Transfer Agent.
	  http://www.busybox.net/tinyutils.html
	  ftp://ftp.debian.org/debian/pool/main/s/ssmtp/
```

## buildroot/package/testshape/Config.in
```kconfig
config BR2_PACKAGE_TESTSHAPE
	bool "testshape"
	default n
	help
	    Traffic Shaping Test Tool
```

## buildroot/package/tool4tpm/Config.in
```kconfig
config BR2_PACKAGE_TOOL4TPM
	bool "tool4tpm"
	default n
	help
	    Infineon tool4tpm
```

## buildroot/package/tpm-tools/Config.in
```kconfig
config BR2_PACKAGE_TPM_TOOLS
    bool "TPM_TOOLS"
    default n
    help
        tpm-tools is an open-source package designed to enable user and application
        enablement of Trusted Computing using a Trusted Platform Module (TPM),
        similar to a smart card environment.  Trusted Computing is a set of
        specifications set forth by the Trusted Computing Group (TCG).  For more
        information on the TCG and Trusted Computing please visit the Trusted
        Computing Group website at:

        http://www.trustedcomputinggroup.org
        http://sourceforge.net/projects/trousers/files/tpm-tools/1.3.8/tpm-tools-1.3.8.tar.gz/download
```

## buildroot/package/tr069/Config.in
```kconfig
config BR2_PACKAGE_TR069
	bool "tr069"
	select BR2_PACKAGE_CA-CERTS
	default n
	help
	DSL Forum TR069 plus related specs: TR098, TR104, TR106, WT107,
	TR110, TR111, WT121, WT140, WT142, WT143, WT151, WT152, WT153,
        or at least the subsets of these that make sense.
        http://www.dslforum.org

config BR2_PACKAGE_EXTRAS_TR069
	bool "tr069 optional build support."
	default n
	depends on BR2_PACKAGE_TR069
	help
	TR069 package binaries to be optionally included in the image.
	If yes, then tr069 binaries will be included in the "full" image but
	not in the "normal(basic)" image.

config BR2_PACKAGE_TR069_INTERNETGATEWAY
	bool "br2_package_tr069_internetgateway"
	default y
	depends on BR2_PACKAGE_TR069
	help
	  Compiles as TR-111 Internet Gateway. Required.

config BR2_PACKAGE_TR069_DEVICE
        bool "br2_package_tr069_device"
        default n
        depends on BR2_PACKAGE_TR069
        help
          Compiles as TR-111 DEVICE

config BR2_PACKAGE_TR069_4CTC
        bool "enable features for Shanghai Research Institute of China Telecom"
        default n
        depends on BR2_PACKAGE_TR069
        help
          Enable features for Shanghai Research Institute of China Telecom
```

## buildroot/package/trousers/Config.in
```kconfig
config BR2_PACKAGE_TROUSERS
    bool "TROUSERS"
    default n
    help
        Trousers is an open-source TCG Software Stack (TSS), released under
        the BSD License. Trousers aims to be compliant with the
        1.1b and 1.2 TSS specifications available from the Trusted Computing
        Group website:

        http://www.trustedcomputinggroup.org
        http://sourceforge.net/projects/trousers/files/latest/download
```

## buildroot/package/tunnelmgr/Config.in
```kconfig
config BR2_PACKAGE_TUNNELMGR
	bool "tunnelmgr"
	default n
	select BR2_PACKAGE_CA-CERTS
	help
	Application to establish data tunnels between APs and WSG Data Blades.
```

## buildroot/package/uboot/Config.in
```kconfig
config BR2_PACKAGE_UBOOT
	bool "uboot"
	default n
	help
	  The uboot bootloader

config BR2_UBOOT_CLEAN_BUILD
	bool "uboot_clean_build"
	depends on BR2_PACKAGE_UBOOT
	help
	  The uboot bootloader clean build

config BR2_PACKAGE_UBOOT_PATH
	string "path to uboot source directory"
#	depends on BR2_PACKAGE_UBOOT
#	default "../atheros/linux/boot/u-boot"
```

## buildroot/package/wget/Config.in
```kconfig
config BR2_PACKAGE_WGET
	bool "wget"
	default n
	select BR2_PACKAGE_CA-CERTS
	help
	  Network utility to retrieve files from http/ftp/etc...

	  http://wget.sunsite.dk/
```

## buildroot/package/wps/Config.in
```kconfig
config BR2_PACKAGE_WPS
	bool "Wi-Fi Protected Setup"
	default n
	help
	  Linux user space daemon for Wi-Fi Protected Setup
		- Registrar
		- Enrolee
		- Registration Protocol
		- UPnP

		** openssl is required for compilation

	  http://www.intel.com/cd/ids/developer/asmo-na/eng/247741.htm
```

## buildroot/package/zip/Config.in
```kconfig
config BR2_PACKAGE_ZIP
	bool "zip"
	default n
	help
		Zip 2.32 is a compression and file packaging utility.

		http://www.info-zip.org/
```

## buildroot/target/Config.in
```kconfig
menu "Target Options"


comment "filesystem for target device"

config BR2_FLASH_ROOTFS
        bool "linux kernel: Kernel to look for rootfs image in flash"
        default n
        help
            Kernel to look for rootfs image in flash.
			rootfs not embedded in kernel.

config BR2_MOUNT_FLASH_ROOTFS
        bool "linux kernel: mount rootfs directly from flash partition."
        depends on BR2_FLASH_ROOTFS
        default n
        help
            mount rootfs directly from image in flash partition.

config BR2_FLASH_ROOTFS
	bool "build flash root file system"
	default n

source "target/cramfs/Config.in"
comment "== jffs2 images ================="
source "target/jffs2/Config.in"
comment "== reiserfs images =============="
source "target/reiserfs/Config.in"
comment "== squashfs images =============="
source "target/squashfs/Config.in"
comment "== ext2 images =================="
source "target/ext2/Config.in"
comment "== tar images ==================="
source "target/tar/Config.in"
comment "== initramfs images ============="
source "target/initramfs/Config.in"
comment "== nfs =========================="
source "target/nfs/Config.in"
comment "== rescue tool kit images ======="
source "target/usbtool/Config.in"
source "target/restoretool/Config.in"
comment "== iso installer ================"
source target/isoinstaller/Config.in"
comment "== vmdk image ==================="
source "target/vmdkimage/Config.in"
#comment "bootloader for target device"

#source "target/x86/grub/Config.in"
#source "target/x86/syslinux/Config.in"
#source "target/powerpc/yaboot/Config.in"

endmenu

#source "target/device/Config.in"
```

## buildroot/target/initramfs/Config.in
```kconfig
config BR2_TARGET_ROOTFS_INITRAMFS
	bool "create /tftpboot/initramfs.gz"
	default n
	help
	  Build a initramfs.gz (cpio.gz) which can be used with bzImage straight
```

## buildroot/target/isoinstaller/Config.in
```kconfig
config BR2_TARGET_ISO_INSTALLER
	bool "Enable ISO Installer"
	depends on BR2_TARGET_USBTOOL_KIT
	default n
	help
	  Build ISO image installer

config BR2_ISO_INSTALLER_TARGET_DIR
	string "ISO installer output path"
	depends on BR2_TARGET_ISO_INSTALLER
	default "$(TFTPBOOT)"
	help
	  Output path of ISO installer
```

## buildroot/target/jffs2/Config.in
```kconfig
config BR2_TARGET_JFFS2
	bool "jffs2 filesystem"
	default y
	help
	  Build jffs2 filesystems

config BR2_TARGET_ROOTFS_JFFS2
	bool "jffs2 root filesystem"
	default n
	depends on BR2_TARGET_JFFS2
	help
	  Build a jffs2 root filesystem

config BR2_TARGET_DATAFS_JFFS2
	bool "jffs2 data filesystem"
	default y
	depends on BR2_TARGET_JFFS2
	help
	  Build a jffs2 data filesystem

config BR2_TARGET_DATAFS_2ND_FLASH_JFFS2
	bool "jffs2 data filesystem - 2nd flash bank"
	default n
	depends on BR2_TARGET_JFFS2
	help
	  Build a jffs2 data filesystem

config BR2_TARGET_DATAFS_JFFS2_16M
	bool "jffs2 data filesystem 16M"
	default y
	depends on BR2_TARGET_JFFS2
	help
	  Build a jffs2 data filesystem

config BR2_TARGET_JFFS2_EBSIZE
	hex "Erase block size"
	depends on BR2_TARGET_JFFS2
	default 0x10000

config BR2_TARGET_JFFS2_EBSIZE_16M
	hex "Erase block size (16M)"
	depends on BR2_TARGET_JFFS2 && BR2_TARGET_DATAFS_JFFS2_16M
	default 0x40000

choice
	prompt "Endianess"
	default BR2_TARGET_JFFS2_BE if BR2_RKS_BOARD_GD6 || BR2_RKS_BOARD_GD4 || BR2_RKS_BOARD_834PN || BR2_RKS_BOARD_TELSEY || BR2_RKS_BOARD_AP51 || BR2_RKS_BOARD_DF1
	depends on BR2_TARGET_JFFS2

config BR2_TARGET_JFFS2_LE
	bool "little-endian"
	depends on BR2_TARGET_JFFS2

config BR2_TARGET_JFFS2_BE
	bool "big-edian"
	depends on BR2_TARGET_JFFS2

endchoice

config BR2_TARGET_ROOTFS_JFFS2_PAD
	bool "Pad output"
	depends on BR2_TARGET_ROOTFS_JFFS2
	depends on BR2_TARGET_DATAFS_JFFS2
	default y

config BR2_TARGET_ROOTFS_JFFS2_PADSIZE
	hex "Pad output size (0x0 = to end of EB)"
	depends on BR2_TARGET_ROOTFS_JFFS2_PAD
	default 0x0
	help
		Set to 0x0 to pad to end of erase block.

config BR2_TARGET_ROOTFS_JFFS2_SQUASH
	bool "Make all files be owned by root"
	depends on BR2_TARGET_ROOTFS_JFFS2
	depends on BR2_TARGET_DATAFS_JFFS2
	default y

config BR2_TARGET_ROOTFS_JFFS2_OUTPUT
	string "Output File"
	depends on BR2_TARGET_ROOTFS_JFFS2
	default "$(BUILD_DIR)/rootfs.jffs2.$(PROFILE)"

config BR2_TARGET_ROOTFS_JFFS2_COPYTO
	string "also copy the image to..."
	depends on BR2_TARGET_ROOTFS_JFFS2
	default "/tftpboot"
	help
		Copies the resulting image to a secondary location.

config BR2_TARGET_DATAFS_JFFS2_OUTPUT
	string "Output File"
	depends on BR2_TARGET_DATAFS_JFFS2
	default "$(BUILD_DIR)/datafs.jffs2.$(PROFILE)"

config BR2_TARGET_DATAFS_JFFS2_OUTPUT_16M
	string "Output File"
	depends on BR2_TARGET_DATAFS_JFFS2_16M && BR2_TARGET_DATAFS_JFFS2_16M
	default "$(BUILD_DIR)/datafs16.jffs2.$(PROFILE)"

config BR2_TARGET_DATAFS_2ND_FLASH_JFFS2_OUTPUT
	string "Output File (2 flash bank case)"
	depends on BR2_TARGET_DATAFS_JFFS2 && BR2_TARGET_DATAFS_2ND_FLASH_JFFS2
	default "$(BUILD_DIR)/datafs.jffs2.2nd_flash.$(PROFILE)"

config BR2_TARGET_DATAFS_JFFS2_COPYTO
	string "also copy the image to..."
	depends on BR2_TARGET_DATAFS_JFFS2
	default "/tftpboot"
	help
		Copies the resulting image to a secondary location.

config BR2_TARGET_DATAFS_JFFS2_PAD
	bool "Pad output"
	depends on BR2_TARGET_DATAFS_JFFS2
	default y

config BR2_TARGET_DATAFS_JFFS2_PADSIZE
	hex "Pad output size (0x0 = to end of EB)"
	depends on BR2_TARGET_DATAFS_JFFS2_PAD
	default 0x70000
	help
		Set to 0x0 to pad to end of erase block.

config BR2_TARGET_DATAFS_JFFS2_PADSIZE_16M
	hex "Pad output size (0x0 = to end of EB)"
	depends on BR2_TARGET_DATAFS_JFFS2_PAD && BR2_TARGET_DATAFS_JFFS2_16M
	default 0x140000
	help
		Set to 0x0 to pad to end of erase block.
```

## buildroot/target/nfs/Config.in
```kconfig
config BR2_TARGET_ROOTFS_NFS
	bool "Copy the rootfs to nfsdir"
	default n
	help
	  Copy the rootfs to a path that can be exported mounting ROOTFS over NFS
	  You need to have sudo previliges for running tar to do this so that the 
	  dev nodes can be created

config BR2_TARGET_ROOTFS_NFS_PATH
	string "Path to the nfs export"
	depends on BR2_TARGET_ROOTFS_NFS
	default "/x"
	help
	   Specify the path to which to copy the entire rootfs to
```

## buildroot/target/pxetool/Config.in
```kconfig
config BR2_TARGET_PXETOOL_KIT
	bool "Enable system pxe tool kits"
	default n
	help
	  Create system pxe tool kits for system rescue.

config BR2_PXE_TOOL_TARGET_DIR
	string "System pxe initramfs output path"
	depends on BR2_TARGET_PXETOOL_KIT
	default "$(TFTPBOOT)/$(PROFILE)/usbtool"
	help
	  Output path to the initramfs of system pxe tool kit
```

## buildroot/target/reiserfs/Config.in
```kconfig
config BR2_TARGET_REISERFS
	bool "reiser filesystem"
	default n 
	help
	  Build reiser filesystems

config BR2_TARGET_DATAFS_REISERFS
	bool "reiser data filesystem"
	default y
	depends on BR2_TARGET_REISERFS
	help
	  Build a reiser data filesystem

config BR2_TARGET_DATAFS_BLOCKS
	string "size in blocks (leave at 0 for auto calculation)"
	depends on BR2_TARGET_DATAFS_REISERFS
	default 0
	help
	  Number of blocks in datafs

config BR2_TARGET_DATAFS_RESERVED_BLOCKS
	string "reserved blocks"
	depends on BR2_TARGET_DATAFS_REISERFS
	default 1024
	help
	  Number of reserved blocks in datafs

config BR2_TARGET_DATAFS_JOURNAL_BLOCKS
	string "journal size in blocks (leave at 0 for default 8193)"
	depends on BR2_TARGET_DATAFS_REISERFS
	default 0
	help
	  Number of journal blocks in datafs (513~32749)

config BR2_TARGET_DATAFS_BLOCK_SIZE
	string "block size in bytes (leave at 0 for default 4096)"
	depends on BR2_TARGET_DATAFS_REISERFS
	default 0
	help
	  Block size in bytes

config BR2_TARGET_DATAFS_REISERFS_ROOT
	bool "Make all files be owned by root"
	depends on BR2_TARGET_DATAFS_REISERFS
	default y
	
config BR2_TARGET_DATAFS_REISERFS_OUTPUT
	string "Output File"
	depends on BR2_TARGET_DATAFS_REISERFS
	default "$(BUILD_DIR)/datafs.reiserfs.$(PROFILE)"

config BR2_TARGET_DATAFS_REISERFS_COPYTO
	string "also copy the image to..."
	depends on BR2_TARGET_DATAFS_REISERFS
	default "/tftpboot"
	help
		Copies the resulting image to a secondary location.
```

## buildroot/target/restoretool/Config.in
```kconfig
config BR2_TARGET_RESTORETOOL_KIT
	bool "Enable system restore tool kits"
	default n
	help
	  Create system restore tool kits for system rescue.

config BR2_RESTORE_TOOL_TARGET_DIR
	string "System restore initramfs output path"
	depends on BR2_TARGET_RESTORETOOL_KIT
	default "$(TFTPBOOT)"
	help
	  Output path to the initramfs of system restore tool kit
config BR2_RESTORE_TOOL_TARGET_VER
	string "Version of system restore tool"
	depends on BR2_TARGET_RESTORETOOL_KIT
	default "0.1"
	help
	  Set restore tool version
```

## buildroot/target/squashfs/Config.in
```kconfig
config BR2_TARGET_ROOTFS_SQUASHFS
	bool "squashfs root filesystem"
	default y
	help
	  Build a squashfs root filesystem

config BR2_TARGET_ROOTFS_SQUASHFS_FILELIST
	bool "Make a listed of file with MD5 for rootfs"
	depends on BR2_TARGET_ROOTFS_SQUASHFS
	default n

config BR2_TARGET_ROOTFS_SQUASHFS_OUTPUT
	string "Output File name"
	depends on BR2_TARGET_ROOTFS_SQUASHFS
	default "ramdisk"
	help
		The value $(BR2_TARGET_ROOTFS_OUTPUT).img needs to to match
		$(CONFIG_EMBEDDED RAMDISK_IMAGE) specified in linux-release.config.
		Note that the suffix .img is added automatically to
		$(BR2_TARGET_ROOTFS_OUTPUT)

config BR2_ROOTFS_RAMDISK_COPYTO
	string "copy the rootfs image to ramdisk location"
	depends on 	BR2_TARGET_ROOTFS_SQUASHFS
#	default "arch/$(BR2_ARCH)/ramdisk/"
	help
	  Copies the resulting rootfs image to the ramdisk location
	  to be linked into the kernel.  Path is relative to kernel tree.

config BR2_TARGET_ROOTFS_SQUASHFS_COPYTO
	string "also copy the image to..."
	depends on 	BR2_TARGET_ROOTFS_SQUASHFS
	default ""
	help
	  Copies the resulting rootfs image to a secondary location
	  like a tftp server's root directory.

config BR2_TARGET_BUILD_BACKUP_IMAGE
	bool "junk non-essential files for barebone backup image"
	default n
	help
	  Remove some non-essential files to pare down backup image size
```
