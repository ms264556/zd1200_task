## buildroot/package/linux-kernel/Config.in
```kconfig
config BR2_LINUX_KERNEL
	bool "linux kernel"
	default y
	help
	  The linux  kernel

choice
	prompt "Linux Kernel Version"
	default BR2_KERNEL_ATHEROS_LATEST
	depends on BR2_LINUX_KERNEL
	help
	  Select the version of linux kernel you wish to use.
	  You must select the correct set of header files to match
	  the kernel you intend to use on your target system.

	config BR2_KERNEL_ATHEROS_LATEST
		bool "Latest atheros linux drop available"

	config  BR2_KERNEL_BROADCOM_LATEST
		bool "Latest broadcom linux drop available"

	config  BR2_KERNEL_BROADCOM_SERCOMM
		bool "Broadcom 963xx kernel from the sercomm branch"

	config  BR2_KERNEL_BROADCOM_TELSEY
		bool "Broadcom 963xx kernel from the sercomm branch"

	config  BR2_KERNEL_RKS_X86
		bool "Ruckus maintained linux kernel for x86 minipci sdk"

endchoice

config BR2_KERNEL_RKS_SYSTEM_TRACE
	bool "Build kernel with system trace support ?"
	default n

config BR2_KERNEL_RKS_SYSTEM_HOOKS
	bool "Build kernel with Ruckus system hook ?"
	default y

config BR2_KERNEL_PATH
	string "kernel path"
	default "../atheros/linux/ap/src/kernels/mips-linux-2.4.25" if BR2_KERNEL_ATHEROS_LATEST
	default "../external/sercomm/bcm963xx/bcm963xx/kernel/linux" if BR2_KERNEL_BROADCOM_LATEST
	default "../external/telsey/bcm963xx/bcm963xx/kernel/linux" if BR2_KERNEL_BROADCOM_TELSEY
	default "../external/gpl/linux-2.6.15" if BR2_KERNEL_RKS_X86
	depends on BR2_LINUX_KERNEL

config BR2_KERNEL_OBJTREE
	bool "kernel objtree in build directory"
	default y
	depends on BR2_LINUX_KERNEL

config BR2_KERNEL_COPYTO
	string "also copy the image to..."
	depends on      BR2_LINUX_KERNEL
	default "/tftpboot"
	help
	  Copies the resulting image to a secondary location.

config BR2_KERNEL_STRIP_DEBUG
	bool "linux kernel: strip -g vmlinux"
	depends on      BR2_LINUX_KERNEL
	default n if BR2_KERNEL_RKS_X86
	default y
	help
	  Strip debugging symbols from vmlinux

config BR2_KERNEL_BINMD5
	bool "linux kernel: attach header to compressed image"
	depends on      BR2_LINUX_KERNEL
	default y
	help
	  Attach header to Lzma compressed image

config BR2_KERNEL_BUILD_DEBUG
	bool "kernel build debug"
	default n
	depends on BR2_LINUX_KERNEL
	help
	  Enable "kgdb" and "-g" for kernel image debug

config BR2_KERNEL_BUILD_FOR_VM
	bool "kernel build for VMware"
	default n
	depends on BR2_LINUX_KERNEL
	depends on BR2_RKS_BOARD_NAR5520
	help
	  Build kernel for that can run on VMware

config BR2_BRIDGE_SET_MAC
	bool "linux kernel: set bridge MAC address directly"
	default n
	help
	  Allow bridge MAC to be set directly instead of taking on the
	  MAC address of an attached interface.
```

## buildroot/package/lldpd/Config.in
```kconfig
config BR2_PACKAGE_LLDPD
    bool "LLDPD"
    default n
    help
        LLDP (Link Layer Discovery Protocol) (also known as 802.1ab) is
        an industry standard protocol designed to supplant proprietary
        Link-Layer protocols such as Extreme's EDP (Extreme Discovery Protocol)
        and CDP (Cisco Discovery Protocol). The goal of LLDP is to provide
        an inter-vendor compatible mechanism to deliver Link-Layer 
        notifications to adjacent network devices.

        https://github.com/vincentbernat/lldpd/wiki
```

## buildroot/package/memcached/Config.in
```kconfig
config BR2_PACKAGE_MEMCACHED
	bool "memcached"
	default n
	help
	    Ruckus memcached lookup daemon.
```

## buildroot/package/miniupnpd/Config.in
```kconfig
config BR2_PACKAGE_MINIUPNPD
	bool "upnpd"
	default n
	help
	  A small footprint UPnP daemon.

	  http://miniupnp.free.fr/
```

## buildroot/package/mosquitto_lbs_sub/Config.in
```kconfig
config BR2_PACKAGE_MOSQUITTO_LBS_SUB
	bool "LBS SUB CLIENT DAEMON"
    default n
	help
	  LBS subscriber daemon
```

## buildroot/package/ndisc6/Config.in
```kconfig
config BR2_PACKAGE_NDISC6
	bool "NDisc6 package"
	default n
	help
	  NDisc6 package
	  NDisc6 is a small collection of useful tools for IPv6 networking
	  Turn on this option to build NDisc6 package and install ndisc6
	  http://www.remlab.net/ndisc6/

config BR2_PACKAGE_NDISC6_NDISC6
	bool "build traceroute6"	
	depends on BR2_PACKAGE_NDISC6
	default n
	help
	  Install traceroute6 from NDisc6 package

config BR2_PACKAGE_NDISC6_TRACEROUTE6
	bool "build traceroute6"	
	depends on BR2_PACKAGE_NDISC6
	default n
	help
	  Install traceroute6 from NDisc6 package

config BR2_PACKAGE_NDISC6_RDISC6
	bool "build traceroute6"	
	depends on BR2_PACKAGE_NDISC6
	default n
	help
	  Install rdisc6 from NDisc6 package
```

## buildroot/package/ndsend/Config.in
```kconfig
config BR2_PACKAGE_NDSEND
	bool "ndsend package"
	default n
	help
	  ndsend - send a Neighbor Advertisement NDP packet 
          The ndsend utility is called by arpsend(8) for IPv6 addresses to send an unsolicited Neighbor
          Advertisement ICMPv6 multicast packet announcing a given IPv6 address to all  IPv6  nodes  as
          per RFC4861.
          Source Code: http://download.openvz.org/utils/vzctl/current/src/
```

## buildroot/package/nuttcp/Config.in
```kconfig
config BR2_PACKAGE_NUTTCP
	bool "nuttcp"
	default n
	help
	  An implementation of the network performance measurement tool .

	  http://sd.wareonearth.com/~phil/net/ttcp/
```

## buildroot/package/openldap/Config.in
```kconfig
config BR2_PACKAGE_OPENLDAP
	bool "openldap"
	default n
	help
	  OpenLDAP pakcage 
```

## buildroot/package/parprouted/Config.in
```kconfig
config BR2_PACKAGE_PARPROUTED
	bool "parprouted"
	default n
	help
	  parprouted is a daemon for transparent IP (Layer 3) proxy ARP bridging.

	  http://www.hazard.maks.net/
```

## buildroot/package/redboot/Config.in
```kconfig
config BR2_PACKAGE_REDBOOT
	bool "redboot"
	default n
	help
	  The redboot bootloader

config BR2_REDBOOT_CLEAN_BUILD
	bool "redboot_clean_build"
	depends on BR2_PACKAGE_REDBOOT
	help
	  The redboot bootloader clean build

config BR2_PACKAGE_REDBOOT_PATH
	string "path to redboot source directory"
	default "../atheros/linux/ap/src/redboot_cobra"
```

## buildroot/package/regdmn_chann/Config.in
```kconfig
config BR2_PACKAGE_REGDMN_CHANN
	bool "regdmn_chann"
	default n
	help
	  country/channel/power setting for stamgr
```

## buildroot/package/reiserfsprogs/Config.in
```kconfig
config BR2_PACKAGE_REISERFSPROGS
	bool "reiserfsprogs"
	default n 
	help
	  The REISER file system utilities and libraries

config BR2_PACKAGE_REISERFSPROGS_SYSTEM
	bool "Install reiserfs utils to the system"
	default n
	depends on BR2_PACKAGE_REISERFSPROGS
	help
	  Install reiserfs utils to the system

config BR2_PACKAGE_REISERFSPROGS_USBTOOL
	bool "Install reiserfs utils to usb tool"
	default y
	depends on BR2_PACKAGE_REISERFSPROGS
	depends on BR2_TARGET_USBTOOL_KIT
	help
	  Install reiserfs utils to usb tool
```

## buildroot/package/release/Config.in
```kconfig
config BR2_BUILD_MULTI_IMAGES
        bool "build both a basic image and a full (including extras) "
        default n
```

## buildroot/package/rks_nbp/Config.in
```kconfig
config BR2_PACKAGE_RKS_NBP
	bool "Ruckus network-based positioning"
	default n
	help
```

## buildroot/package/rksaim/Config.in
```kconfig
config BR2_PACKAGE_RKSAIM
	bool "rksaim"
	default n
	select BR2_PACKAGE_LIBNL
	help
	  Ruckus AP deamon to support Aiming
```

## buildroot/package/rksblistd/Config.in
```kconfig
config BR2_PACKAGE_RKSBLISTD
	bool "rksblistd"
	default n
	help
          Ruckus daemon to support wireless non-root bridges to inform root bridge of 
          interference
```

## buildroot/package/rkschano/Config.in
```kconfig
config BR2_PACKAGE_RKSCHANO
	bool "rkschano"
	default n
	help
	  Ruckus deamon to support 802.11 Channel Optimization
```

## buildroot/package/rksconfig/Config.in
```kconfig
config BR2_PACKAGE_RKSCONFIG
	bool "rksconfig"
	default y
	depends on BR2_PACKAGE_MADWIFI_SMARTCAST && BR2_PACKAGE_LIBCCL
	help
	  Ruckus Configuration Utility.
```

## buildroot/package/rp-pppoe/Config.in
```kconfig
config BR2_PACKAGE_RP_PPPOE
	bool "roaring penguin pppoe client"
	default n
	help
	  An implementation of the PPPOE client

	  http://www.roaringpenguin.com/
```

## buildroot/package/rpkitpm/Config.in
```kconfig
config BR2_PACKAGE_RPKITPM
	bool "rpkitpm"
	default n
	help
	    Ruckus rpki-tpm-tool
```

## buildroot/package/rpmkeytest/Config.in
```kconfig
config BR2_PACKAGE_RPMKEYTEST
	bool "rpmKeyTest"
	default n
	help
	    Ruckus RPM Key Testing Framework
```

## buildroot/package/ruda/Config.in
```kconfig
config BR2_PACKAGE_RUDA
	bool "RUDA, Ruckus Unified Discovery Agent"
	default n
	help
	  RUDA Ruckus Unified Discovery Agent for Access point
```
